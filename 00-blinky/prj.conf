## Kconfig
```
mainmenu "Blinky Application Configuration"
config BLINK_ENABLE
    bool "Enable Blinking LED"
    default y
    help
      Enable or disable the blinking LED functionality in the application.

config BLINK_INTERVAL
    int "Blink Interval (ms)"
    default 1000
    depends on BLINK_ENABLE
    help
      Set the interval (in milliseconds) for how often the LED should blink.


source "Kconfig.zephyr"
```

## prj.conf
```kconfig
#samples/basic/blinky/
CONFIG_GPIO=y
CONFIG_BLINK_ENABLE=y
CONFIG_BLINK_INTERVAL=200
```

## src/main.c
```c
/*
 * Copyright (c) 2016 Intel Corporation
 *
 * SPDX-License-Identifier: Apache-2.0
 */

#include <stdio.h>
#include <zephyr/kernel.h>
#include <zephyr/drivers/gpio.h>

/* The devicetree node identifier for the "led0" alias. */
#define LED0_NODE DT_ALIAS(led0)

/*
 * A build error on this line means your board is unsupported.
 * See the sample documentation for information on how to fix this.
 */
static const struct gpio_dt_spec led = GPIO_DT_SPEC_GET(LED0_NODE, gpios);

int main(void)
{
	int ret;
	bool led_state = true;

	if (!gpio_is_ready_dt(&led)) {
		return 0;
	}

	ret = gpio_pin_configure_dt(&led, GPIO_OUTPUT_ACTIVE);
	if (ret < 0) {
		return 0;
	}

	printf("Hello World! %s\r\n", CONFIG_BOARD_TARGET);
	
#ifdef CONFIG_BLINK_ENABLE
	while (1) {
		ret = gpio_pin_toggle_dt(&led);
		if (ret < 0) {
			return 0;
		}

		led_state = !led_state;
		printf("LED state: %s\n", led_state ? "ON" : "OFF");
		k_msleep(CONFIG_BLINK_INTERVAL);
		//k_msleep(1000);
	}
#endif
	return 0;
}
```
